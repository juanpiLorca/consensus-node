## async/nordic/build/Kconfig/arch/Kconfig
```kconfig
# Load arch Kconfig descriptions.
osource "/home/juanignaciolorca/ncs/v2.7.0/zephyr/arch/x86/Kconfig"
osource "/home/juanignaciolorca/ncs/v2.7.0/zephyr/arch/xtensa/Kconfig"
osource "/home/juanignaciolorca/ncs/v2.7.0/zephyr/arch/sparc/Kconfig"
osource "/home/juanignaciolorca/ncs/v2.7.0/zephyr/arch/riscv/Kconfig"
osource "/home/juanignaciolorca/ncs/v2.7.0/zephyr/arch/posix/Kconfig"
osource "/home/juanignaciolorca/ncs/v2.7.0/zephyr/arch/nios2/Kconfig"
osource "/home/juanignaciolorca/ncs/v2.7.0/zephyr/arch/mips/Kconfig"
osource "/home/juanignaciolorca/ncs/v2.7.0/zephyr/arch/arm64/Kconfig"
osource "/home/juanignaciolorca/ncs/v2.7.0/zephyr/arch/arm/Kconfig"
osource "/home/juanignaciolorca/ncs/v2.7.0/zephyr/arch/arc/Kconfig"
```
