## prj.conf
```kconfig
# Enable Logger module
CONFIG_LOG=n

# Enable utton and LED library
CONFIG_DK_LIBRARY=y

# Enable BT LE
CONFIG_BT=y
CONFIG_BT_DEVICE_NAME="LABCTRL"
CONFIG_BT_BROADCASTER=y
CONFIG_BT_OBSERVER=y

# Enable the serial driver in asynchronous mode
CONFIG_SERIAL=y
CONFIG_UART_ASYNC_API=y

# Increase stack size for the main thread and System Workqueue
CONFIG_SYSTEM_WORKQUEUE_STACK_SIZE=2048
CONFIG_MAIN_STACK_SIZE=2048
```

## src/main.c
```c
// Include modules
#include <zephyr/kernel.h>
#include <zephyr/logging/log.h>
#include <dk_buttons_and_leds.h>
#include <zephyr/bluetooth/bluetooth.h>
#include <zephyr/bluetooth/gap.h>
#include <math.h>
#include <stdlib.h>
#include "common.h"
#include "observer.h"
#include "broadcaster.h"
#include "serial.h"
#define M_PI 3.14159265358979323846

// Register the logger for this module
LOG_MODULE_REGISTER(Module_Main, LOG_LEVEL_INF);

// For status led
#define STATUS_LED DK_LED1
#define BLINK_INTERVAL 1000

// For threads
#define STACKSIZE 2048
#define THREAD_CONSENSUS_PRIORITY 7

// Auxiliar function for starting LEDs
void leds_start(void) {
	int err = dk_leds_init();
	if (err) {
		LOG_ERR("Status LED failed to start (err %d)\n", err);
		return;
	}
	LOG_INF("Status LED successfully started\n");
}

// Auxiliar function for starting BT
void bt_start(void) {
    int err = bt_enable(NULL);
	if (err) {
		LOG_ERR("Bluetooth failed to start (err %d)\n", err);
		return;
	}
	LOG_INF("Bluetooth successfully started\n");
}

// Auxiliar sign function
float sign(float x) {
    if (x > 0) {
        return 1.0;
    } else if (x < 0) {
        return -1.0;
    } else {
        return 0.0;
    }
}

// Auxiliar function for computing consensus law
float v_i(consensus_params* cp) {
    float vstate_f = (float)cp->vstate;
    float vi = 0.0f;
    for (int j = 0; j < cp->N; j++) {
        if (cp->neighbor_enabled[j]) {
            float diff = vstate_f - (float)cp->neighbor_states[j];
            vi += -1.0f * sign(diff) * sqrtf(fabsf(diff));
        }
    }
    return vi;
}


// Auxiliar function for updating the consensus algorithm
void update_consensus(consensus_params *cp) {

	if (cp->algorithm == ALGO_FINITE_TIME) {
		// For finite time consensus algorithm: Javier's consensus algorithm
		float x = (float)cp->state;
		float z = (float)cp->vstate;
		float vartheta = (float)(cp->gamma * 0.001);
		float eta = (float)(cp->lambda * 0.000001);

		// Disturbance parameters
		float cnt = (float)cp->disturbance.counter;
		float off = (float)cp->disturbance.offset;
		float amp = (float)cp->disturbance.amplitude;
		float pha = (float)(cp->disturbance.phase * 0.01);
		float Ns = (float)cp->disturbance.samples;
		float norm_noise = cp->disturbance.random ? (float)rand() / (float)RAND_MAX : sinf(2.0f * M_PI * ( (cnt/Ns) - pha ));
		float disturbance = off + amp * norm_noise;

		// 2. Compute error term and gradients
		float sigma = x - z; 
		float grad = sign(sigma); 
	
		// 3. Compute control input
		float vi = v_i(cp);
		float gi = vi; 
		float ui = gi - vartheta * grad; 
	
		// 4. Update dynamic variables
		cp->state = (int32_t)(x + ui + disturbance);
		cp->vstate = (int32_t)(z + gi);
		cp->gamma = (int32_t)(vartheta + eta * sign(sigma) * sign(sigma));
		cp->ui = ui;

		// 5. Update disturbance parameters & log info.
		cp->disturbance.counter = (cp->disturbance.counter + 1) % cp->disturbance.samples;
		LOG_INF("x: %d, z: %d, vartheta: %d, sigma: %d, state: %d", (int32_t)x, (int32_t)z, (int32_t)vartheta, (int32_t)sigma, cp->state);
	} else {
		LOG_ERR("Unknown algorithm type: %d", cp->algorithm);
		return;
	}
}

// Thread: Main (just for blinking a LED)
int main(void) {
	// Start status LED and the BLE stack
	int blink_status = 0;
	leds_start();
	bt_start();
	serial_start();
	while (1) {
		dk_set_led(STATUS_LED, (++blink_status) % 2);
		k_sleep(K_MSEC(consensus.Ts));
	}
}

// Thread: Consensus Algorithm
void thread_consensus(void) {
	custom_data_type custom_data = {MANUFACTURER_ID, consensus.enabled ? NETID_ENABLED : NETID_DISABLED, consensus.node, consensus.vstate};
	static neighbor_info_type neighbor_info;
	while (1) {
		if (consensus.running) {
			if (consensus.first_time_running) {
				custom_data.netid_enabled = consensus.enabled ? NETID_ENABLED : NETID_DISABLED;
				custom_data.node = consensus.node;
				custom_data.vstate = consensus.vstate;
				broadcaster_start(&custom_data);
				observer_start();
				serial_log_consensus();
				consensus.first_time_running = false;
			}
			if (consensus.all_neighbors_observed) {
				if (!k_msgq_get(&custom_observer_msg_queue, &neighbor_info, K_FOREVER)) {
					if (consensus.enabled) {
					    memcpy(consensus.neighbor_states, neighbor_info.vstates, sizeof(neighbor_info.vstates));
					    memcpy(consensus.neighbor_enabled, neighbor_info.enabled, sizeof(neighbor_info.enabled));
					    update_consensus(&consensus);
					}
					custom_data.netid_enabled = consensus.enabled ? NETID_ENABLED : NETID_DISABLED;
					custom_data.vstate = consensus.vstate;
		    		broadcaster_update_scan_response_custom_data(&custom_data);
				    serial_log_consensus();
		    	}
			}
		}
		k_sleep(K_MSEC(consensus.Ts));
	}
}

// Init the threads
K_THREAD_DEFINE(thread_consensus_id, STACKSIZE, thread_consensus, NULL, NULL, NULL, THREAD_CONSENSUS_PRIORITY, 0, 0);
```

## src/broadcaster.c
```c
// Include modules
#include "broadcaster.h"
#include <zephyr/logging/log.h>

// Register the logger for this module
LOG_MODULE_REGISTER(Module_Broadcaster, LOG_LEVEL_INF);

// Function that initialize the broadcaster with scan response
int broadcaster_start(custom_data_type* custom_data)
{
	struct bt_data ad[] = {
		BT_DATA(BT_DATA_NAME_COMPLETE, DEVICE_NAME, DEVICE_NAME_LEN),
		BT_DATA(BT_DATA_MANUFACTURER_DATA, (unsigned char *)custom_data, sizeof(custom_data_type))
	};
    int err = bt_le_adv_start(BT_LE_ADV_NCONN, ad, ARRAY_SIZE(ad), ad, ARRAY_SIZE(ad));
	if (err) {
		LOG_ERR("Advertising failed to start (err %d)\n", err);
		return err;
	}
	LOG_INF("Advertising successfully started\n");
	return 0;
}

// Function that updates the broadcaster with scan response
int broadcaster_update_scan_response_custom_data(custom_data_type* custom_data)
{
	struct bt_data ad[] = {
		BT_DATA(BT_DATA_NAME_COMPLETE, DEVICE_NAME, DEVICE_NAME_LEN),
		BT_DATA(BT_DATA_MANUFACTURER_DATA, (unsigned char *)custom_data, sizeof(custom_data_type))
	};
	int err = bt_le_adv_update_data(ad, ARRAY_SIZE(ad), ad, ARRAY_SIZE(ad));
	if (err) {
		LOG_ERR("Advertising failed to update (err %d)\n", err);
		return err;
	}
	LOG_INF("Advertising successfully updated: value = %d \n", custom_data->vstate);
	return 0;
	
}
```

## src/common.h
```c
#ifndef COMMON_H_
#define COMMON_H_

// For BT device name
#define DEVICE_NAME CONFIG_BT_DEVICE_NAME
#define DEVICE_NAME_LEN (sizeof(DEVICE_NAME) - 1)
#define MANUFACTURER_ID 0x0059
#define NETID_ENABLED 0x7F
#define NETID_DISABLED 0x70
#define N_MAX_NEIGHBORS 4

// For algorithm type
#define ALGO_TYPE_ORIGINAL 0
#define ALGO_TYPE_INTEGRAL 1
#define ALGO_TYPE_PI_LPF 2

// Javier's consensus algorithm: 
#define ALGO_FINITE_TIME 3

// Custom type to represent a data 
typedef struct {
	uint16_t manufacturer;  // Unique universal manufacturer ID
	uint8_t netid_enabled;  // This is for network filtering and considering the node for udpating in the algorithm
	uint8_t node;			// The ID of the in the custom network

	// The virtual state value of the node (it is used in the consensus algorithm)
	int32_t vstate;			// A number (note that int32_t is aligned with uint16_t for "man" and uint16_t for "id")
} custom_data_type;

#define CUSTOM_DATA_TYPE_SIZE sizeof(custom_data_type)

#endif // COMMON_H_
```

## src/observer.c
```c
// Include modules
#include "observer.h"
#include "serial.h"
#include <zephyr/logging/log.h>

// Register the logger for this module
LOG_MODULE_REGISTER(Module_Observer, LOG_LEVEL_INF);

// Internal module variables                               
static neighbor_info_type neighbor_info;
K_MSGQ_DEFINE(custom_observer_msg_queue, sizeof(neighbor_info_type), 1, 4);	// define the queue (the size of the queue is 1)

// Define a function to map NEIGHBOR_i_IDs to their respective indices
static int8_t map_node_to_index(uint8_t node) {
	for (int i=0; i < consensus.N; i++) {
		if (consensus.neighbors[i] == node) {
			return i;
		}
	}
	return -1;
}

// Private Callback: On data parsed (called after device has been found)
static bool on_data_parse_after_device_found(struct bt_data *data, void *user_data) {
	custom_data_type *custom_data = user_data;
	switch (data->type) {
		// When getting the manufacturer data (since it can be placed in broadcasting or in scan_response):
		case BT_DATA_MANUFACTURER_DATA:
			if (data->data_len == CUSTOM_DATA_TYPE_SIZE) {
				memcpy(custom_data, data->data, CUSTOM_DATA_TYPE_SIZE);
				// Make sure the data is of our network
				if (custom_data->manufacturer == MANUFACTURER_ID && (custom_data->netid_enabled == NETID_ENABLED || custom_data->netid_enabled == NETID_DISABLED)) { 
					int8_t node_index = map_node_to_index(custom_data->node);
					if (node_index >= 0) {
					    if (!consensus.all_neighbors_observed) {
					    	consensus.available_neighbors[node_index] = true;
					    	int N = 0;
					    	for (int i = 0; i < consensus.N; i++) {
					    		if (consensus.available_neighbors[i]) {
					    			N++;
					    		}
					    	}
					    	if (N == consensus.N) {
					    		consensus.all_neighbors_observed = true;
					    	}
					    }
					    // Update the message queue with the state value of the node (it only updates the place of a node in the array of neighbor values)
					    neighbor_info.vstates[node_index] = custom_data->vstate;
					    neighbor_info.enabled[node_index] = (custom_data->netid_enabled == NETID_ENABLED) ? true : false;
					    while (k_msgq_put(&custom_observer_msg_queue, &neighbor_info, K_NO_WAIT) != 0) {
            		    	k_msgq_purge(&custom_observer_msg_queue);		// This logic deletes previous state values in the queue
        			    }
					    LOG_INF("id: %d, vstate: %d, enabled: %d", custom_data->node, neighbor_info.vstates[node_index], neighbor_info.enabled[node_index]);
					    //LOG_INF("SCANNED_NODE_ID: %d, SCANNED_NODE_VALUE %d, NEIGHBOR_INDEX %d, NEIGHBOR_STATE %d \n", custom_data->node, custom_data->state, map_node_to_index(custom_data->node), neighbor_states[map_node_to_index(custom_data->node)]);
					}
				}
			}
			return false;
		default:
			return true;
	}
}

// Private Callback: On device found (it just call the parser)
static void on_device_found(const bt_addr_le_t *addr, int8_t rssi, uint8_t type, struct net_buf_simple *ad) {
	// Parse the scanned data to a parse callback
	char ad_parsed[BT_GAP_ADV_MAX_ADV_DATA_LEN];
	bt_data_parse(ad, on_data_parse_after_device_found, ad_parsed);
}

// Public function: start the observer 
int observer_start(void) {
	struct bt_le_scan_param scan_param = {
		.type       = BT_LE_SCAN_TYPE_ACTIVE,			// This enables to send scan requests
		.options    = BT_LE_SCAN_OPT_FILTER_DUPLICATE,
		.interval   = BT_GAP_SCAN_FAST_INTERVAL,
		.window     = BT_GAP_SCAN_FAST_WINDOW,
	};
	int err = bt_le_scan_start(&scan_param, on_device_found);
	if (err) {
		LOG_ERR("Scanning failed to start (err %d)\n", err);
		return err;
	}
	LOG_INF("Scanning successfully started\n");
	return 0;
}
```

## src/observer.h
```c
#ifndef OBSERVER_H_
#define OBSERVER_H_

// Include modules
#include <zephyr/bluetooth/bluetooth.h>
#include <zephyr/bluetooth/hci.h>
#include "common.h"

// Define a type for the message queue
typedef struct {
    
    int32_t vstates[N_MAX_NEIGHBORS];    // to store the virtual state values of the neighbors: Javier's consensus algorithm

    bool enabled[N_MAX_NEIGHBORS];      // to store whether the neighbor is enabled or not
} neighbor_info_type;

// Declare the message queue as extern to be used outside the observer module
extern struct k_msgq custom_observer_msg_queue;

// Declare public functions
int observer_start(void);

#endif // OBSERVER_H_
```

## src/serial.c
```c
// Include modules
#include "serial.h"
#include <stdlib.h>
#include <zephyr/kernel.h>
#include <zephyr/logging/log.h>

// Register the logger for this module
LOG_MODULE_REGISTER(Module_Serial, LOG_LEVEL_INF);

// Public boolean to know if the consensus algorithm has received a triggered signal
static bool available_neighbors[N_MAX_NEIGHBORS] = {false};
static uint8_t neighbors[N_MAX_NEIGHBORS] = {1};
static int32_t neighbor_states[N_MAX_NEIGHBORS] = {100};
static bool neighbor_enabled[N_MAX_NEIGHBORS] = {false};
consensus_params consensus = {
	false,					// running
	false,					// enabled	
	true,					// first_time_running
	false,					// all_neighbors_observed
	available_neighbors,	// avaliable_neighbors
	0,						// node
	neighbors,				// neigbors
	1,						// number of neighbors = N
	0,						// time0 (internal clock time)
	0,						// algorithm type
	1000,					// period of the consensus task
	100,					// initial state

	10,						// initial virtual state: Javier's consensus algorithm

	50,						// initial gamma
	1,						// lambda parameter
	50,                     // pole parameter
	0,  					// error dead zone parameeter
	100,					// state variable

	10,						// virtual state variable: Javier's consensus algorithm

	50,						// gamma variable
	0.0,    				// error variable
	0.0,					// error DC variable
	0.0,					// integral (PI) manipulated variable
	neighbor_states,		// neighbor states
	neighbor_enabled,		// neighbor enabled
	{false, 0, 0, 0, 0, 0}  // disturbance parameters
};		

// Get the device pointer of the UART hardware
const struct device *uart = DEVICE_DT_GET(DT_NODELABEL(uart0));

// Define the receive buffer
static uint8_t rx_buf[RX_BUFF_SIZE];

// Define the send buffer
static uint8_t tx_buf[TX_BUFF_SIZE];

// Define the callback function for UART
static void uart_cb(const struct device *dev, struct uart_event *evt, void *user_data){
	switch (evt->type) {
	    case UART_RX_RDY:
			// Read all the characters stored in the rx buffer and check if it is present the EOL character
			for (int i=evt->data.rx.offset; i < evt->data.rx.offset+evt->data.rx.len; i++) {
				uint8_t c = evt->data.rx.buf[i];
				if (c== '\r' || c=='\n') {
					// The first byte is the type of message
                    uint8_t type = evt->data.rx.buf[0];
                    uint8_t *pt;
                    uint8_t cnt;
                    switch (type) {
                    	// When receiving consensus trigger type
                    	case 't':
                    		if (evt->data.rx.buf[1] != '0') {
                    			consensus.running = true;
                    			consensus.first_time_running = true;
                    			consensus.all_neighbors_observed = false;
								consensus.disturbance.counter = 0;
								consensus.error = 0.0;
								consensus.error_dc = 0.0;
								consensus.ui = 0.0;
                    			consensus.time0 = k_uptime_get();
                    			consensus.state = consensus.state0;

								consensus.vstate = consensus.vstate0; // Initialize virtual state

                    			consensus.gamma = consensus.gamma0;
                    			for (int i = 0; i < N_MAX_NEIGHBORS; i++) {
                    				consensus.available_neighbors[i] = false;
                    				consensus.neighbor_states[i] = consensus.state0;
									consensus.neighbor_enabled[i] = false;
                    			}
                    		} else {
                    			consensus.running = false;
                    		}
                    		LOG_INF("running: %d. time0: %lld", consensus.running, consensus.time0);
                    		break;
                    	// When receiving network related type
                    	case 'n':
                    	    pt = strtok(&(evt->data.rx.buf[1]), ",");
                    		cnt = 0;
                    		while (pt != NULL) {
                    			uint8_t id = atoi(pt);
                    			if (cnt == 0) {
									consensus.enabled = (id == 1);
								} else if (cnt == 1) {
                    				consensus.node = id;
                    			} else {
                    				consensus.neighbors[cnt-2] = id;
                    			}
                    			cnt++;
                    		    pt = strtok(NULL, ",");
                    		}
                    		consensus.N = cnt-2;
                    		LOG_INF("enabled: %d. node: %d. N: %d", consensus.enabled, consensus.node, consensus.N);
                    		for (int i = 0; i < consensus.N; i++) {
                    			LOG_INF("neighbor: index = %d. id: %d.", i, consensus.neighbors[i]);
                    		}
                    		break;
                    	// When receiving algorithm related type
                    	case 'a':
                    	    pt = strtok(&(evt->data.rx.buf[1]), ",");
                    		cnt = 0;
                    		while (pt != NULL) {
                    		    int32_t value = atoi(pt);
                    			switch (cnt) {
									case 0:
                    					consensus.algorithm = value;
                    					break;
                    				case 1:
                    					consensus.Ts = value;
                    					break;
                    				case 2:
                    					consensus.state0 = value;
                    					break;
                    				case 3:
                    					consensus.gamma0 = value;
                    					break;
                    				case 4:
                    					consensus.lambda = value;
                    					break;
									case 5:
                    					consensus.pole = value;
                    					break;
									case 6:
                    					consensus.dead = value;
										break;
									case 7:
                    					consensus.disturbance.random = (value == 1);
										break;
									case 8:
                    					consensus.disturbance.offset = value;
                    					break;
									case 9:
                    					consensus.disturbance.amplitude = value;
                    					break;
									case 10:
                    					consensus.disturbance.phase = value;
                    					break;
									case 11:
                    					consensus.disturbance.samples = value;
                    					break;
									case 12:
										consensus.vstate0 = value; // Set the initial virtual state for Javier
                    				default:
                    					break;
                    			}
                    			cnt++;
                    		    pt = strtok(NULL, ",");
                    		}
                    		LOG_INF("Ts: %d. state0: %d. gamma0: %d. lambda: %d.", consensus.Ts, consensus.state0, consensus.gamma0, consensus.lambda);
                    		break;
                    	default:
                    		LOG_ERR("The received message has unknown type");
                    		break;
                    }
                    // Diseable rx to reset the offset of the rx buffer
                    uart_rx_disable(dev);
					break;
				}
			}
			break;
	    case UART_RX_DISABLED:
		    uart_rx_enable(dev, rx_buf, sizeof rx_buf, RX_TIMEOUT);
		    break;
	    default:
		    break;
	}
}

// Function to start serial
void serial_start() {
	// Verify that the UART device is ready
	if (!device_is_ready(uart)) {
		LOG_ERR("Serial not ready");
		return;
	}
	// Set the uart callback
	int err = uart_callback_set(uart, uart_cb, NULL);
	if (err) {
		LOG_ERR("Serial failed to start (err %d)\n", err);
		return;
	}
	// Start receiving by calling uart_rx_enable() and pass it the address of the receive buffer
	err = uart_rx_enable(uart, rx_buf, sizeof rx_buf, RX_TIMEOUT);
	if (err) {
		LOG_ERR("Serial failed to enable read (err %d)\n", err);
		return;
	}
	
	LOG_INF("Serial successfully started\n");
	return;
}

// Function to send the log data over serial
void serial_log_consensus() {
    // Prepare the string in the format "dtime,gamma,state,nieghbor_state1,nieghbor_state2\n\r"
	int64_t timestamp = k_uptime_get() - consensus.time0;
    int len = snprintf((char *)tx_buf, sizeof(tx_buf), "d%lld,%d,%d,%d", timestamp, consensus.gamma, consensus.state, consensus.vstate);
	// Append neighbor states to the buffer (we need to ensure we don't ecxeed TX buffer size)
	for (int i = 0; i < consensus.N; i++) {
    	len += snprintf((char *)tx_buf + len, sizeof(tx_buf) - len, ",%d", consensus.neighbor_states[i]);
	}
	len += snprintf(tx_buf + len, sizeof(tx_buf) - len, "\n\r");
    // Send data asynchronously using uart_tx (I don't care if the tx is problematic, so I don't get the error)
    uart_tx(uart, tx_buf, len, SYS_FOREVER_US);
}
```

## src/serial.h
```c
#ifndef SERIAL_H_
#define SERIAL_H_

// Include modules
#include <zephyr/drivers/uart.h>
#include "common.h"

// Definitions
#define TX_BUFF_SIZE 64
#define RX_BUFF_SIZE 64
#define RX_TIMEOUT 50000   //50000us = 50ms = 0.05s. If this is too small, then we will not receive a full string from application

// Custom type to store disturbance parameters sent by a user through uart
typedef struct {
    uint32_t counter;   // Counter
    bool random;        // Boolean to define random noise
    int32_t offset;     // Disturbance offset
    int32_t amplitude;  // Disturbance amplitude
    int32_t phase;      // Phase of the disturbance
    uint32_t samples;   // Number of samples
} disturbance_params;

// Custom type to store consensus parameters sent by a user through uart
typedef struct {
    bool running;
    bool enabled;
    bool first_time_running;
    bool all_neighbors_observed;
    bool* available_neighbors;
    uint8_t node;
    uint8_t* neighbors;
	uint8_t N;
    int64_t time0;
    uint8_t algorithm;
    int32_t Ts;
    int32_t state0;

    // Virtual state added for Javier's consensus algorithm
    int32_t vstate0;

    int32_t gamma0;
    int32_t lambda;
    int32_t pole;
    int32_t dead;
    int32_t state;

    // Virtual state for the consensus algorithm
    int32_t vstate;

    int32_t gamma;
    float error;
    float error_dc;
    float ui;

    int32_t* neighbor_states; // Neighbor vstates for Javier's consensus algorithm

    bool* neighbor_enabled;
    disturbance_params disturbance;
} consensus_params;

// Public boolean to know if the consensus algorithm has received a triggered signal
extern consensus_params consensus;

// Declare public functions
void serial_start(void);
void serial_log_consensus();

#endif // SERIAL_H_
```
