## CMakeLists.txt
```
cmake_minimum_required(VERSION 3.20.0)

find_package(Zephyr REQUIRED HINTS $ENV{ZEPHYR_BASE})
project(NONE)

# NORDIC SDK APP START
target_sources(app PRIVATE
  src/main.c
  src/broadcaster.c
  src/observer.c
  src/serial.c
)

# NORDIC SDK APP END
zephyr_library_include_directories(.)
```

## prj.conf
```kconfig
# Enable logger module
CONFIG_LOG=n

# Enable button and LED library 
CONFIG_DK_LIBRARY=y

# Enable BT-LE
CONFIG_BT=y
CONFIG_BT_DEVICE_NAME="LABCTRL"
CONFIG_BT_BROADCASTER=y
CONFIG_BT_OBSERVER=y

# Enable the serial driver in asynchronous mode
CONFIG_SERIAL=y
CONFIG_UART_ASYNC_API=y

# Increase stack size for the main thread and System Workqueue
CONFIG_SYSTEM_WORKQUEUE_STACK_SIZE=2048
CONFIG_MAIN_STACK_SIZE=2048
```

## src/main.c
```c
#include <zephyr/kernel.h>
#include <zephyr/logging/log.h>
#include <dk_buttons_and_leds.h>
#include <zephyr/bluetooth/bluetooth.h>
#include <zephyr/bluetooth/gap.h>
#include <math.h>
#include <stdlib.h>

#include "consensus.h"
#include "common.h"
#include "observer.h"
#include "broadcaster.h"
#include "serial.h"

#define M_PI 3.14159265358979323846f

// Register the logger for this module 
LOG_MODULE_REGISTER(Module_Main, LOG_LEVEL_INF); 

/**
 * Led status
 */
#define LED_STATUS                  DK_LED1
#define BLINK_INTERVAL_MS           1000
/**
 * Thread stack size and priority
 */
#define STACK_SIZE                  2048
#define THREAD_CONSENSUS_PRIORITY   7

/**
 * Function declarations: --------------------------------------------------------------
 */
static void leds_init(void);                        // Auxiliary function for starting LEDs
static void bt_init(void);                          // Auxiliary function for starting Bluetooth
static float disturbance(consensus_params* cp);     // Auxiliary function to compute disturbance
static float sign(float x);                         // Auxiliary function to get the sign of a float number
static float v_i(consensus_params* cp);             // Function to compute the v_i term in the consensus algorithm
static void update_consensus(consensus_params* cp); // Function to update the consensus algorithm
static void thread_consensus(void);                 // Thread to run the consensus algorithm periodically
/*
 * -------------------------------------------------------------------------------------
 */

/**
 * Main thread:
 */
int main(void) {

    int blink_status = 0; 

    leds_init();
    bt_init();
    serial_init();

    while (1) {
        dk_set_led(LED_STATUS, (++blink_status) % 2);
        k_sleep(K_MSEC(consensus.Ts));
    }
}

/**
 * Consensus thread:
 */
K_THREAD_DEFINE(thread_consensus_id, STACK_SIZE,
                thread_consensus, NULL, NULL, NULL,
                THREAD_CONSENSUS_PRIORITY, 0, 0);

/**
 * Function definitions: --------------------------------------------------------------
 */

static void leds_init(void) {
	int err = dk_leds_init();
	if (err) {
		LOG_ERR("Status LED failed to start (err %d)\n", err);
		return;
	}
	LOG_INF("Status LED successfully started\n");
}

static void bt_init(void) {
    int err = bt_enable(NULL);
	if (err) {
		LOG_ERR("Bluetooth failed to start (err %d)\n", err);
		return;
	}
	LOG_INF("Bluetooth successfully started\n");
}

static float disturbance(consensus_params* cp) {
    float nu = 0.0f;
    if (!cp->disturbance.disturbance_on) {
        nu = 0.0f; 
    } else {
        // Scaling factors
        float amp = (float)cp->disturbance.amplitude * cp->inv_scale_factor;
        float off = (float)cp->disturbance.offset * cp->inv_scale_factor;
        float beta = (float)cp->disturbance.beta * cp->inv_scale_factor;
        float A = (float)cp->disturbance.A * cp->inv_scale_factor; 
        float f = (float)cp->disturbance.frequency;                                    
        float phi_shift_s = (float)cp->disturbance.phase * cp->inv_scale_factor;       
        float t = (float)cp->disturbance.counter * (float)cp->dt; 

        float m = amp * ((float)rand() / (float)RAND_MAX - off); 
        
        float sinusoidal = A * sinf(2.0f * M_PI * f * (t - phi_shift_s));
        nu = m + beta + sinusoidal;
    } 
    return nu; 
}

static float sign(float x) {
    if (x > 0.0f) {
        return 1.0f;
    } else if (x < 0.0f) {
        return -1.0f;
    } else {
        return 0.0f;
    }
}

static float v_i(consensus_params* cp) {
    float vstate_f = (float)(cp->vstate * cp->inv_scale_factor);
    float vi = 0.0f;
    for (int j = 0; j < cp->N; j++) {
        if (cp->neighbor_enabled[j]) {
            float diff = vstate_f - (float)(cp->neighbor_vstates[j] * cp->inv_scale_factor);
            vi += -1.0f * sign(diff) * sqrtf(fabsf(diff));
        }
    }
    return vi;
}

static void update_consensus(consensus_params* cp) {

    // 1. Cast to float for calculations: system and disturbance parameters

    // Dynamic variables & parameters
    float dt = (float)(cp->dt * cp->inv_scale_factor); 
    float x = (float)(cp->state * cp->inv_scale_factor);
    float z = (float)(cp->vstate * cp->inv_scale_factor);
    float vartheta = (float)(cp->vartheta * cp->inv_scale_factor);
    float eta = (float)(cp->eta * cp->inv_scale_factor);

    // Disturbance: 
    float nu = disturbance(cp);

    // 2. Compute error term and gradients
    float sigma = x - z; 
    float grad = sign(sigma); 

    // 3. Compute control input
    float vi = v_i(cp);
    float gi = vi; 
    float ui = gi - vartheta * grad; 

    // 4. Compute dvtheta (derivative of vartheta): hysteresis bounding 
    float dvtheta = 0.0f; 
    if (cp->active == 0){ 
        if ((float)fabs(sigma) > cp->epsilonON){
            cp->active = 1;
            dvtheta = eta * 1.0f; 
        } else {
            dvtheta = 0.0f; 
        }
    } else {
        if ((float)fabs(sigma) <= cp->epsilonOFF){
            cp->active = 0;
            dvtheta = 0.0f; 
        } else {
            dvtheta = eta * 1.0f; 
        }
    }

    // 5. Update dynamic variables
    cp->state = (int32_t)((x + dt * (ui + nu)) * cp->scale_factor);
    cp->vstate = (int32_t)((z + dt * gi) * cp->scale_factor);
    cp->vartheta = (int32_t)((vartheta + dt * dvtheta) * cp->scale_factor);

    // 6. Update disturbance parameters & log info.
    cp->disturbance.counter = (cp->disturbance.counter + 1) % cp->disturbance.samples;
}

static void thread_consensus(void) {
    custom_data_type custom_data = {
        MANUFACTURER_ID, 
        consensus.enabled ? NETID_ENABLED : NETID_DISABLED, 
        consensus.node, 
        consensus.vstate
    };

    static neighbor_info_type neighbor_info; 
    while (1) {
        if (consensus.running) {
			if (consensus.first_time_running) {
				custom_data.netid_enabled = consensus.enabled ? NETID_ENABLED : NETID_DISABLED;
				custom_data.node = consensus.node;
				custom_data.vstate = consensus.vstate;
				broadcaster_init(&custom_data);
				observer_init();
				serial_log_consensus();
				consensus.first_time_running = false;
			}
			if (consensus.all_neighbors_observed) {
				if (!k_msgq_get(&custom_observer_msg_queue, &neighbor_info, K_FOREVER)) {
					if (consensus.enabled) {
					    memcpy(consensus.neighbor_vstates, neighbor_info.vstates, sizeof(neighbor_info.vstates));
					    memcpy(consensus.neighbor_enabled, neighbor_info.enabled, sizeof(neighbor_info.enabled));
					    update_consensus(&consensus);
					}
					custom_data.netid_enabled = consensus.enabled ? NETID_ENABLED : NETID_DISABLED;
					custom_data.vstate = consensus.vstate;
		    		broadcaster_update_scan_response_custom_data(&custom_data);
				    serial_log_consensus();
		    	}
			}
		}
		k_sleep(K_MSEC(consensus.Ts));
    }
}


// static void thread_consensus(void) {
//     custom_data_type custom_data = { ... };
//     static neighbor_info_type neighbor_info; 
    
//     while (1) {
//         if (consensus.running) {
            
//             // 1. ASYNCHRONOUS NETWORK INPUT UPDATE (0.1s rate)
//             // Executes the following block ONLY when a new message arrives from the observer thread.
//             if (!k_msgq_get(&custom_observer_msg_queue, &neighbor_info, K_NO_WAIT)) { 
//                 if (consensus.all_neighbors_observed) {
//                     // Update the neighbor inputs used by the dynamics
//                     memcpy(consensus.neighbor_vstates, neighbor_info.vstates, sizeof(neighbor_info.vstates));
//                     memcpy(consensus.neighbor_enabled, neighbor_info.enabled, sizeof(neighbor_info.enabled));
//                 }
                
//                 // 3. SLOW ASYNCHRONOUS OUTPUT REPORTING (0.1s rate)
//                 // Executes ONLY when the input is updated, giving you the flexibility you want.
//                 serial_log_consensus(); // <-- This is executed at the 0.1s rate
//             }
            
//             if (consensus.enabled) {
//                 // 2. SYNCHRONOUS DYNAMICS EXECUTION (1ms rate)
//                 // Runs every 1ms, using the neighbor data updated at 0.1s.
//                 update_consensus(&consensus);
//             }
            
//             // 4. BROADCAST UPDATE (can be 1ms or 0.1s, depending on BLE load)
//             // It's often best to only update the broadcast state (which neighbors read) when the
//             // consensus calculation *uses* a new network input (i.e., inside the k_msgq_get block).
//             // For simplicity, let's keep it inside the k_msgq_get block alongside serial_log_consensus.
//             // If you put it here, it will run every 1ms, increasing BLE advertising load. 

//         }
        
//         // 5. FAST LOOP TIMER (1ms rate)
//         k_sleep(K_MSEC(consensus.Ts));
//     }
// }
```

## src/broadcaster.c
```c
// Include modules
#include "broadcaster.h"
#include <zephyr/logging/log.h>

// Register the logger for this module
LOG_MODULE_REGISTER(Module_Broadcaster, LOG_LEVEL_INF);

/**
 * Type variable to control many aspects of the advertising 
 * --> it could replace the default advertising parameters given by BT_LE_ADV_NCONN
 */
// static const struct bt_le_adv_param *adv_param =
// 	BT_LE_ADV_PARAM(BT_LE_ADV_OPT_NONE, /* No options specified */
// 	800, /* Min Advertising Interval 500ms (800*0.625ms) */
// 	801, /* Max Advertising Interval 500.625ms (801*0.625ms) */
// 	NULL /* Set to NULL for undirected advertising */
// ); /* Set to NULL for undirected advertising */
            

/** 
 * Function that initialize the broadcaster with scan response
 */
int broadcaster_init(custom_data_type* custom_data)
{
	struct bt_data ad[] = {
		BT_DATA(BT_DATA_NAME_COMPLETE, DEVICE_NAME, DEVICE_NAME_LEN),
		BT_DATA(BT_DATA_MANUFACTURER_DATA, (unsigned char *)custom_data, sizeof(custom_data_type))
	};
	// Min adv time is 100ms, max is 150ms
    int err = bt_le_adv_start(BT_LE_ADV_NCONN, ad, ARRAY_SIZE(ad), ad, ARRAY_SIZE(ad));
	if (err) {
		LOG_ERR("Advertising failed to start (err %d)\n", err);
		return err;
	}
	LOG_INF("Advertising successfully started\n");
	return 0;
}

/**
 * Function that updates the broadcaster with scan response
 */
int broadcaster_update_scan_response_custom_data(custom_data_type* custom_data)
{
	struct bt_data ad[] = {
		BT_DATA(BT_DATA_NAME_COMPLETE, DEVICE_NAME, DEVICE_NAME_LEN),
		BT_DATA(BT_DATA_MANUFACTURER_DATA, (unsigned char *)custom_data, sizeof(custom_data_type))
	};
	int err = bt_le_adv_update_data(ad, ARRAY_SIZE(ad), ad, ARRAY_SIZE(ad));
	if (err) {
		LOG_ERR("Advertising failed to update (err %d)\n", err);
		return err;
	}
	//LOG_INF("Advertising successfully updated: value = %d \n", custom_data->vstate);
	return 0;
	
}
```

## src/broadcaster.h
```c
#ifndef BROADCASTER_H_
#define BROADCASTER_H_

// Include modules
#include <zephyr/bluetooth/bluetooth.h>
#include <zephyr/bluetooth/gap.h>
#include "common.h"

// Declare public functions
int broadcaster_start(custom_data_type* custom_data);
int broadcaster_update_scan_response_custom_data(custom_data_type* custom_data);

#endif // BROADCASTER_H_
```

## src/common.h
```c
#ifndef COMMON_H_
#define COMMON_H_

/**
 * BT device name and advertising parameters
 */
#define DEVICE_NAME         CONFIG_BT_DEVICE_NAME
#define DEVICE_NAME_LEN     (sizeof(DEVICE_NAME) - 1)
#define MANUFACTURER_ID     0x0059
#define NETID_ENABLED       0x7F
#define NETID_DISABLED      0x70
#define N_MAX_NEIGHBORS     4

// Custom type to represent a data 
typedef struct {
	uint16_t manufacturer;  // Unique universal manufacturer ID
	uint8_t netid_enabled;  // This is for network filtering and considering the node for udpating in the algorithm
	uint8_t node;			// The ID of the in the custom network
	int32_t state;			// A number (note that int32_t is aligned with uint16_t for "man" and uint16_t for "id")
    int32_t vstate;        // The virtual state of the node
} custom_data_type;

#define CUSTOM_DATA_TYPE_SIZE sizeof(custom_data_type)

#endif // COMMON_H_
```

## src/consensus.c
```c
#include <math.h>
#include "consensus.h"

float disturbance(consensus_params* cp) {
    float nu = 0.0f;
    if (!cp->disturbance.disturbance_on) {
        nu = 0.0f; 
    } else {
        // Scaling factors
        float amp = (float)cp->disturbance.amplitude * cp->inv_scale_factor;
        float off = (float)cp->disturbance.offset * cp->inv_scale_factor;
        float beta = (float)cp->disturbance.beta * cp->inv_scale_factor;
        float A = (float)cp->disturbance.A * cp->inv_scale_factor; 
        float f = (float)cp->disturbance.frequency;                                    
        float phi_shift_s = (float)cp->disturbance.phase * cp->inv_scale_factor;       
        float t = (float)cp->disturbance.counter * (float)cp->dt * cp->inv_scale_factor; // dt must be scaled to seconds
        float m = amp * ((float)rand() / (float)RAND_MAX - off); 
        float sinusoidal = A * sinf(2.0f * M_PI * f * (t - phi_shift_s));
        nu = m + beta + sinusoidal;
    } 
    return nu; 
}

float sign(float x) {
    if (x > 0.0f) {
        return 1.0f;
    } else if (x < 0.0f) {
        return -1.0f;
    } else {
        return 0.0f;
    }
}

float max_of_two_non_negative_f(float a, float b) {
    float max_val = fmaxf(a, b);
    return fmaxf(0.0f, max_val); 
}

float v_i(consensus_params* cp) {
    float vstate_f = (float)(cp->vstate * cp->inv_scale_factor);
    float vi = 0.0f;
    for (int j = 0; j < cp->N; j++) {
        if (cp->neighbor_enabled[j]) {
            float diff = vstate_f - (float)(cp->neighbor_vstates[j] * cp->inv_scale_factor);
            vi += -1.0f * sign(diff) * sqrtf(fabsf(diff));
        }
    }
    return vi;
}

void update_consensus(consensus_params* cp) {
    float dt = (float)(cp->dt) * 1e-3f; // Convert ms to seconds
    float x = (float)(cp->state * cp->inv_scale_factor);
    float z = (float)(cp->vstate * cp->inv_scale_factor);
    float vartheta = (float)(cp->vartheta * cp->inv_scale_factor);
    float eta = (float)(cp->eta * cp->inv_scale_factor);

    float nu = disturbance(cp);
    float sigma = x - z; 
    float grad = sign(sigma); 
    float vi = v_i(cp);
    float gi = vi; 
    float ui = gi - vartheta * grad; 

    float dvtheta = 0.0f; 
    if (cp->active == 0){ 
        if ((float)fabs(sigma) > cp->epsilonON){
            cp->active = 1;
            dvtheta = eta * 1.0f; 
        } else {
            dvtheta = 0.0f; 
        }
    } else {
        if ((float)fabs(sigma) <= cp->epsilonOFF){
            cp->active = 0;
            dvtheta = 0.0f; 
        } else {
            dvtheta = eta * 1.0f; 
        }
    }
    cp->state = (int32_t)((x + 1.0f * (ui + nu)) * cp->scale_factor);          // removed: dt *
    cp->vstate = (int32_t)((z + 1.0f * gi) * cp->scale_factor);                // removed: dt *
    cp->vartheta = (int32_t)((vartheta + 1.0f * dvtheta) * cp->scale_factor);  // removed: dt *
    cp->disturbance.counter = (cp->disturbance.counter + 1) % cp->disturbance.samples;
}
```

## src/consensus.h
```c
#ifndef CONSENSUS_H
#define CONSENSUS_H

#include <stdlib.h>
#include <stdint.h>
#include <zephyr/kernel.h>
#include "common.h"

/**
 * Custom type to store disturbance parameters sent by user through UART
 */
typedef struct {
    bool disturbance_on; 
    // Uniform disturbance parameters:
    int32_t offset;
    int32_t amplitude;
    // Constant disturbance parameter:
    int32_t beta;
    // Sinusoidal disturbance parameters:
    int32_t A;
    int32_t frequency;
    int32_t phase; 
    uint32_t counter; 
    uint32_t samples; 
} disturbance_params;

/**
 * Custom type to store consensus parameters sent by user through UART
 */
typedef struct {
    bool running; 
    bool enabled; 
    bool first_time_running; 
    bool all_neighbors_observed; 

    bool* available_neighbors; 

    uint8_t node; 
    uint8_t* neighbors; 

    float scale_factor; 
    float inv_scale_factor; 
    float scale_eta; 

    uint8_t N; 
    int64_t time0; 
    int32_t Ts; 
    int32_t dt; 
    int32_t state0; 
    int32_t vstate0; 
    int32_t vartheta0;
    int32_t eta; 
    int32_t state; 
    int32_t vstate;
    int32_t vartheta;

    uint8_t active; 
    float epsilonON;
    float epsilonOFF; 

    bool* neighbor_enabled; 
    int32_t* neighbor_vstates;

    disturbance_params disturbance;
} consensus_params;

/**
 * Public boolean to know if the consensus algorithm has received the triggered signal
 * 
 */
extern consensus_params consensus;

#endif // CONSENSUS_H
```

## src/observer.c
```c
#include "observer.h"
#include "serial.h"
#include <zephyr/logging/log.h>

// Register the logger for this module
LOG_MODULE_REGISTER(Module_Observer, LOG_LEVEL_INF);

// Internal module variables                               
static neighbor_info_type neighbor_info;
K_MSGQ_DEFINE(custom_observer_msg_queue, sizeof(neighbor_info_type), 1, 4);	// define the queue (the size of the queue is 1)

/**
 * Function to map NEIGHBOR_i_IDs to their respective indices
 */
static int8_t map_node_to_index(uint8_t node) {
	for (int i = 0; i < consensus.N; i++) {
		if (consensus.neighbors[i] == node) {
			return i;
		}
	}
	return -1;
}

/** 
 * Private Callback: On data parsed (called after device has been found)
 */
static bool on_data_parse_after_device_found(struct bt_data *data, void *user_data) {
	custom_data_type *custom_data = user_data;
	switch (data->type) {

		// When getting the manufacturer data (since it can be placed in broadcasting or in scan_response):
		case BT_DATA_MANUFACTURER_DATA:
			if (data->data_len == CUSTOM_DATA_TYPE_SIZE) {
				memcpy(custom_data, data->data, CUSTOM_DATA_TYPE_SIZE);

				// Make sure the data is of our network
				if (custom_data->manufacturer == MANUFACTURER_ID && (custom_data->netid_enabled == NETID_ENABLED || custom_data->netid_enabled == NETID_DISABLED)) { 
					int8_t node_index = map_node_to_index(custom_data->node);

					if (node_index >= 0) {
					    if (!consensus.all_neighbors_observed) {
					    	consensus.available_neighbors[node_index] = true;
					    	int N = 0;
					    	for (int i = 0; i < consensus.N; i++) {
					    		if (consensus.available_neighbors[i]) {
					    			N++;
					    		}
					    	}
					    	if (N == consensus.N) {
					    		consensus.all_neighbors_observed = true;
					    	}
					    }

					    // Update the message queue with the state value of the node (it only updates the place of a node in the array of neighbor values)
                        neighbor_info.vstates[node_index] = custom_data->vstate; 
					    neighbor_info.enabled[node_index] = (custom_data->netid_enabled == NETID_ENABLED) ? true : false;

					    while (k_msgq_put(&custom_observer_msg_queue, &neighbor_info, K_NO_WAIT) != 0) {
            		    	k_msgq_purge(&custom_observer_msg_queue);		// This logic deletes previous state values in the queue
        			    }
					    //LOG_INF("id: %d, vstate: %d, enabled: %d", custom_data->node, neighbor_info.vstates[node_index], neighbor_info.enabled[node_index]);
					}
				}
			}
			return false;

		default:
			return true;
	}
}

/**
 * Private Callback: On device found (it just call the parser)
 */
static void on_device_found(const bt_addr_le_t *addr, int8_t rssi, uint8_t type, struct net_buf_simple *ad) {
	// Parse the scanned data to a parse callback
	char ad_parsed[BT_GAP_ADV_MAX_ADV_DATA_LEN];
	bt_data_parse(ad, on_data_parse_after_device_found, ad_parsed);
}

/**
 * Public function: start the observer 
 */
int observer_init(void) {
	struct bt_le_scan_param scan_param = {
		.type       = BT_LE_SCAN_TYPE_ACTIVE,			// This enables to send scan requests
		.options    = BT_LE_SCAN_OPT_FILTER_DUPLICATE,
		.interval   = BT_GAP_SCAN_FAST_INTERVAL,
		.window     = BT_GAP_SCAN_FAST_WINDOW,
	};
	int err = bt_le_scan_start(&scan_param, on_device_found);
	if (err) {
		LOG_ERR("Scanning failed to start (err %d)\n", err);
		return err;
	}
	LOG_INF("Scanning successfully started\n");
	return 0;
}
```

## src/observer.h
```c
#ifndef OBSERVER_H_
#define OBSERVER_H_

// Include modules
#include <zephyr/bluetooth/bluetooth.h>
#include <zephyr/bluetooth/hci.h>
#include "consensus.h"
#include "common.h"

// Define a type for the message queue
typedef struct {
    int32_t states[N_MAX_NEIGHBORS];    // to store the state values of the neighbors
    int32_t vstates[N_MAX_NEIGHBORS];   // to store the virtual state of the neighbors 
    bool enabled[N_MAX_NEIGHBORS];      // to store whether the neighbor is enabled or not
} neighbor_info_type;

// Declare the message queue as extern to be used outside the observer module
extern struct k_msgq custom_observer_msg_queue;

// Declare public functions
int observer_init(void);

#endif // OBSERVER_H_
```

## src/serial.c
```c
#include <stdlib.h>
#include <string.h> 
#include <zephyr/kernel.h>
#include <zephyr/logging/log.h>
#include <zephyr/drivers/uart.h>
#include <zephyr/device.h>
#include <zephyr/devicetree.h>
#include "consensus.h"
#include "serial.h" 

// Register the logger for this module
LOG_MODULE_REGISTER(Module_Serial, LOG_LEVEL_INF);

static bool available_neighbors[N_MAX_NEIGHBORS] = {false};
static bool neighbor_enabled[N_MAX_NEIGHBORS] = {false};
static uint8_t neighbors[N_MAX_NEIGHBORS] = {1};
static int32_t neighbor_vstates[N_MAX_NEIGHBORS] = {50};

// Consensus parameters structure (using global scope for access in all functions)
consensus_params consensus = {
    false,                  // running
    false,                  // enabled  
    true,                   // first_time_running
    false,                  // all_neighbors_observed
    available_neighbors,    // avaliable_neighbors
    0,                      // node
    neighbors,              // neigbors
    1e6f,                   // scale_factor
    1e-6f,                  // inv_scale_factor
    1e-4f,                  // scale_eta
    1,                      // number of neighbors = N
    0,                      // time0 (internal clock time)
    1000,                   // period of the consensus task
    1000,                   // "dt": integration step 
    100,                    // initial state
    50,                     // initial vstate
    0,                      // initial vartheta
    0,                      // eta
    100,                    // state 
    50,                     // vstate
    1,                      // vartheta
    0,                      // active boolean
    0.075f,                 // epsilonON
    0.010f,                 // epsilonOFF
    neighbor_enabled,       // neighbor enabled
    neighbor_vstates,       // neighbor vstates
    {false, 0, 0, 0, 0, 0, 0, 0, 0}  // disturbance parameters
};  

/**
 * Device pointer to the UART hardware
 */
const struct device *uart = DEVICE_DT_GET(DT_NODELABEL(uart0)); 

// Buffers for TX and RX data
static uint8_t tx_buf[TX_BUFF_SIZE];
static uint8_t rx_buf[RX_BUFF_SIZE];

/**
 * Function to send the logged data over serial:
 */
void serial_log_consensus() {
    if (!consensus.running) {
        return; // Only log when the algorithm is active
    }
    
    // Prepare the string format: "dtime,state,vstate,vartheta,neighbor_vstate1,neighbor_vstate2,...neighbor_vstateN\n\r"
    int64_t timestamp = k_uptime_get() - consensus.time0; 
    int len = snprintf(
        (char *)tx_buf, sizeof(tx_buf), 
        "d%lld,%d,%d,%d", 
        timestamp, 
        consensus.state, 
        consensus.vstate, 
        consensus.vartheta
    );

    // Append neighbor states to the buffer making sure we do not exceed de Tx buffer size
    for (int i = 0; i < consensus.N; i++) {
        len += snprintf((char *)tx_buf + len, sizeof(tx_buf) - len, ",%d", consensus.neighbor_vstates[i]); 
    }

    len += snprintf((char *)tx_buf + len, sizeof(tx_buf) - len, "\n\r"); 

    // Send data asynchronously using uart_tx
    uart_tx(uart, tx_buf, len, SYS_FOREVER_US); 
}

/**
 * Callback function to handle UART events
 */
static void uart_cb(const struct device *dev, struct uart_event *evt, void *user_data) {
    switch (evt->type) {

        case UART_RX_RDY: {
            
            // Temporary buffer to safely copy the received message for strtok parsing.
            char msg_buffer[RX_BUFF_SIZE];
            size_t rx_len = evt->data.rx.offset + evt->data.rx.len;
            
            // Check for line ending within the new received data
            for (int i=evt->data.rx.offset; i < rx_len; i++) {
                uint8_t c = evt->data.rx.buf[i];

                if (c == '\r' || c == '\n') {
                    
                    // --- SAFETY COPY AND NULL TERMINATION ---
                    // Copy data from rx_buf (which is re-used by the driver) into local msg_buffer.
                    size_t full_msg_len = (i < rx_len) ? i + 1 : rx_len;
                    full_msg_len = (full_msg_len < RX_BUFF_SIZE) ? full_msg_len : RX_BUFF_SIZE - 1;
                    strncpy(msg_buffer, (char *)evt->data.rx.buf, full_msg_len);
                    msg_buffer[full_msg_len] = '\0';
                    // ---------------------------------------

                    // The actual start of the message is the first byte of the copied buffer
                    uint8_t type = msg_buffer[0]; 
                    char *pt;
                    uint8_t cnt; 

                    switch (type) {

                        // When receiving network configuration type: 'n'
                        case 'n':
                            // Start parsing after the message type (at index 1)
                            pt = strtok(msg_buffer + 1, ",");
                            cnt = 0;

                            while (pt != NULL) {
                                uint8_t id = atoi(pt); 

                                if (cnt == 0) {
                                    consensus.enabled = (id == 1); 
                                } else if (cnt == 1) {
                                    consensus.node = id; 
                                } else {
                                    consensus.neighbors[cnt-2] = id; 
                                }

                                cnt++; 
                                pt = strtok(NULL, ",");
                            }

                            consensus.N = cnt - 2; 
                            LOG_INF("Network parameters updated over serial");
                            LOG_INF("Node ID: %d, Enabled: %d, Neighbors: ", consensus.node, consensus.enabled);
                            for (int k = 0; k < consensus.N; k++) {
                                LOG_INF("%d ", consensus.neighbors[k]);
                            }
                            break; 

                        // When receiving consensus trigger type: 't'
                        case 't': 
                            if (msg_buffer[1] != '0') {
                                consensus.running = true; 
                                consensus.first_time_running = true; 
                                consensus.all_neighbors_observed = false;
                                consensus.disturbance.counter = 0;
                                consensus.time0 = k_uptime_get();
                                consensus.state = consensus.state0;
                                consensus.vstate = consensus.vstate0;
                                consensus.vartheta = consensus.vartheta0;
                                
                                for (int k = 0; k < N_MAX_NEIGHBORS; k++) {
                                    consensus.available_neighbors[k] = false;
                                    consensus.neighbor_vstates[k] = consensus.vstate0;
                                    consensus.neighbor_enabled[k] = false;
                                }
                                LOG_INF("Received 't1' (trigger). Consensus running"); 
                            } else {
                                consensus.running = false;
                                LOG_INF("Received 't0' (stop). Consensus stopped");
                            }
                            break;

                        // When receiving core algorithm parameters: 'a' (6 parameters)
                        case 'a': 
                            pt = strtok(msg_buffer + 1, ","); 
                            cnt = 0; 
                            
                            while (pt != NULL) {
                                int32_t value = atoi(pt); 
                                switch (cnt) {
                                    case 0:  consensus.Ts           = value;        break;
                                    case 1:  consensus.dt           = value;        break; 
                                    case 2:  consensus.state0       = value;        break; 
                                    case 3:  consensus.vstate0      = value;        break; 
                                    case 4:  consensus.vartheta0    = value;        break; 
                                    case 5:  consensus.eta          = value;        break; 
                                    default: break;
                                }
                                cnt++; 
                                pt = strtok(NULL, ",");
                            }
                            LOG_INF("Algorithm parameters updated over serial.");
                            LOG_INF("Ts: %d, dt: %d, state0: %d, vstate0: %d, vartheta0: %d, eta: %d", 
                                consensus.Ts, consensus.dt, consensus.state0, consensus.vstate0, consensus.vartheta0, consensus.eta);
                            break;
                        
                        // When receiving disturbance related type: 'p' (8 parameters)
                        case 'p': 
                            pt = strtok(msg_buffer + 1, ","); 
                            cnt = 0; 
                            
                            while (pt != NULL) {
                                int32_t value = atoi(pt); 
                                switch (cnt) {
                                    case 0: consensus.disturbance.disturbance_on = (value == 1); break;
                                    case 1: consensus.disturbance.amplitude      = value;        break; 
                                    case 2: consensus.disturbance.offset         = value;        break; 
                                    case 3: consensus.disturbance.beta           = value;        break;
                                    case 4: consensus.disturbance.A              = value;        break;
                                    case 5: consensus.disturbance.frequency      = value;        break;
                                    case 6: consensus.disturbance.phase          = value;        break;
                                    case 7: consensus.disturbance.samples        = value;        break; 
                                    default: break;
                                }
                                cnt++; 
                                pt = strtok(NULL, ",");
                            }
                            LOG_INF("Disturbance parameters updated over serial.");
                            LOG_INF("Disturbance - on: %d, amplitude: %d, offset: %d, beta: %d, A: %d, frequency: %d, phase: %d, samples: %d", 
                                consensus.disturbance.disturbance_on, consensus.disturbance.amplitude, consensus.disturbance.offset, consensus.disturbance.beta,    
                                consensus.disturbance.A, consensus.disturbance.frequency, consensus.disturbance.phase, consensus.disturbance.samples);
                            break;
     
                        default: 
                            LOG_ERR("The received message has unknown type: %c.", type); 
                            break; 
                    }
                    
                    // Disable Rx to reset the offset of the Rx Buffer
                    uart_rx_disable(dev); 
                    break; 
                }
            }
            break; 
        } 
        
        case UART_RX_DISABLED: 
            // Re-enable RX after processing the message
            uart_rx_enable(dev, rx_buf, sizeof(rx_buf), RX_TIMEOUT); 
        
        default: 
            break; 
    }
}

/**
 * Function to start serial:
 */
void serial_init() {

    if (!device_is_ready(uart)) {
        LOG_ERR("Serial not ready!"); 
        return; 
    }

    int err = uart_callback_set(uart, uart_cb, NULL); 
    if (err) {
        LOG_ERR("Serial failed to set callback (err %d)\n", err);
        return;
    }

    err = uart_rx_enable(uart, rx_buf, sizeof rx_buf, RX_TIMEOUT);
    if (err) {
        LOG_ERR("Serial failed to enable read (err %d)\n", err);
        return;
    }
    
    // DEBUG: Log initialization success
    LOG_INF("Serial successfully initialized and RX is enabled.");
    return;
}
```

## src/serial.h
```c
#ifndef SERIAL_H_
#define SERIAL_H_

// Include modules
#include <zephyr/drivers/uart.h>
#include "common.h"

// Definitions
#define TX_BUFF_SIZE 64
#define RX_BUFF_SIZE 64
#define RX_TIMEOUT 50000   //50000us = 50ms = 0.05s. If this is too small, then we will not receive a full string from application

// Custom type to store disturbance parameters sent by a user through uart
typedef struct {
    uint32_t counter;   // Counter
    bool random;        // Boolean to define random noise
    int32_t offset;     // Disturbance offset
    int32_t amplitude;  // Disturbance amplitude
    int32_t phase;      // Phase of the disturbance
    uint32_t samples;   // Number of samples
} disturbance_params;

// Custom type to store consensus parameters sent by a user through uart
typedef struct {
    bool running;
    bool enabled;
    bool first_time_running;
    bool all_neighbors_observed;
    bool* available_neighbors;
    uint8_t node;
    uint8_t* neighbors;
	uint8_t N;
    int64_t time0;
    uint8_t algorithm;
    int32_t Ts;
    int32_t state0;
    int32_t gamma0;
    int32_t lambda;
    int32_t pole;
    int32_t dead;
    int32_t state;
    int32_t gamma;
    float error;
    float error_dc;
    float ui;
    int32_t* neighbor_states;
    bool* neighbor_enabled;
    disturbance_params disturbance;

    // ---- Finite-Time Robust Adaptive Coordination ---
    int32_t vstate;             // virtual reference system for agent i: z_i
    int32_t vstate0;            // initial virtual reference system for agent i: z_i0
    int32_t* neighbor_vstates;  // neighbor virtual reference systems
    int32_t sigma;              // tracking error for agent i: sigma_i = x_i - z_i
    int32_t eta;                // adaptive step gain. 
    int32_t vartheta;           // adaptive gain for agent i: vartheta_i
    int32_t vartheta0;          // initial adaptive gain for agent i: vartheta_i0
    // ---- Finite-Time Robust Adaptive Coordination ---

} consensus_params;

// Public boolean to know if the consensus algorithm has received a triggered signal
extern consensus_params consensus;

// Declare public functions
void serial_start(void);
void serial_log_consensus();

#endif // SERIAL_H_
```
